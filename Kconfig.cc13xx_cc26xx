## Kconfig.cc13xx_cc26xx
```kconfig
# Copyright (c) 2022 Florin Stancu <niflostancu@gmail.com>
# SPDX-License-Identifier: Apache-2.0

config ADC_CC13XX_CC26XX
	bool "CC13XX/CC26XX ADC driver"
	default y
	depends on DT_HAS_TI_CC13XX_CC26XX_ADC_ENABLED
	help
	  Enable the TI CC13XX/CC26XX ADC driver.

config I2C_CC13XX_CC26XX
	bool "TI SimpleLink CC13xx / CC26xx I2C driver"
	default y
	depends on DT_HAS_TI_CC13XX_CC26XX_I2C_ENABLED
	help
	  Enable support for I2C on the TI SimpleLink CC13xx / CC26xx series.
```
